## boards/shields/crust/Kconfig.defconfig
```kconfig
if SHIELD_CRUST_LEFT

config ZMK_KEYBOARD_NAME
    default "crust"

config ZMK_SPLIT_ROLE_CENTRAL
    default y

config ZMK_SPLIT_BLE_ROLE_CENTRAL
	default y

endif

if SHIELD_CRUST_LEFT || SHIELD_CRUST_RIGHT

    config ZMK_SPLIT
        default y

endif
```

## boards/shields/crust/Kconfig.shield
```kconfig
config SHIELD_CRUST_LEFT
    def_bool $(shields_list_contains,crust_left)

config SHIELD_CRUST_RIGHT
    def_bool $(shields_list_contains,crust_right)
```
